## boards/shields/lily58_tp/Kconfig.shield
```kconfig
# Copyright (c) 2020 Pete Johanson
# SPDX-License-Identifier: MIT

config SHIELD_LILY58_TP_LEFT
    def_bool $(shields_list_contains,lily58_tp_left)

config SHIELD_LILY58_TP_RIGHT
    def_bool $(shields_list_contains,lily58_tp_right)
```
